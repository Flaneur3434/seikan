## wireguard-baremetal/platform/main/Kconfig
```kconfig
menu "WiFi Configuration"

config WIFI_SSID
    string "WiFi SSID"
    default "wifi"
    help
        SSID (network name) to connect to.

config WIFI_PASSWORD
    string "WiFi Password"
    default "password"
    help
        WiFi password (WPA2/WPA3).

endmenu

menu "WireGuard"

menu "Keys"

config WG_STATIC_PRIVATE_KEY
    string "WireGuard static private key (hex)"
    default ""
    help
        ESP32 static private X25519 key as 64 hex characters.
        Generate with: python build.py keygen

endmenu

menu "Peer 1"

config WG_PEER_PUBLIC_KEY
    string "Public key (hex)"
    default ""
    help
        Remote peer 1 static public X25519 key as 64 hex characters.
        This is the Python test side's public key.
        Generate with: python build.py keygen

config WG_PRESHARED_KEY
    string "Pre-shared key (hex, optional)"
    default ""
    help
        Optional 32-byte pre-shared key as 64 hex characters.
        Leave empty for no PSK (all-zero).
        Generate with: python build.py keygen --psk

config WG_PEER1_ALLOWED_IP
    string "AllowedIP (dotted quad)"
    default "0.0.0.0"
    help
        Network address for peer 1's AllowedIPs entry.
        Default 0.0.0.0 routes all traffic through this peer.

config WG_PEER1_ALLOWED_PREFIX
    int "AllowedIP prefix length"
    default 0
    range 0 32
    help
        CIDR prefix length for peer 1's AllowedIPs entry.
        Default 0 = 0.0.0.0/0 (route everything).

config WG_PEER1_KEEPALIVE
    int "Persistent keepalive (seconds)"
    default 25
    range 0 3600
    help
        Persistent keepalive interval in seconds (0 = disabled).
        25 seconds is recommended for NAT traversal (§6.5).

endmenu

menu "Peer 2"

config WG_PEER2_PUBLIC_KEY
    string "Public key (hex)"
    default ""
    help
        Remote peer 2 static public X25519 key as 64 hex characters.
        Leave empty to disable peer 2.

config WG_PEER2_PRESHARED_KEY
    string "Pre-shared key (hex, optional)"
    default ""
    help
        Optional 32-byte pre-shared key for peer 2.
        Leave empty for no PSK (all-zero).

config WG_PEER2_ALLOWED_IP
    string "AllowedIP (dotted quad)"
    default "0.0.0.0"
    depends on WG_PEER2_PUBLIC_KEY != ""
    help
        Network address for peer 2's AllowedIPs entry.

config WG_PEER2_ALLOWED_PREFIX
    int "AllowedIP prefix length"
    default 0
    range 0 32
    depends on WG_PEER2_PUBLIC_KEY != ""
    help
        CIDR prefix length for peer 2's AllowedIPs entry.

config WG_PEER2_KEEPALIVE
    int "Persistent keepalive (seconds)"
    default 25
    range 0 3600
    depends on WG_PEER2_PUBLIC_KEY != ""
    help
        Persistent keepalive interval in seconds (0 = disabled).

endmenu

endmenu
```
